const int NBLED=14;
const int NBSEQUENCES=17;
int pinLed[14]={0,1,2,3,4,5,6,7,8,9,10,11,12,13};

boolean affichage[NBSEQUENCES][NBLED]={
  0,0,0,0,0,0,0,0,0,0,0,0,0,0,
  1,0,0,0,0,0,0,0,0,0,0,0,0,0,
  0,1,0,0,0,0,0,0,0,0,0,0,0,0,
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  1,1,1,1,1,1,1,1,1,1,1,1,1,1};

void setup() {
  for (int i=0;i<NBLED;i++)
  {
    pinMode(pinLed[i],OUTPUT);
    digitalWrite(pinLed[i],LOW);
  }
  
}

void loop() {
  for (int i=0;i<NBSEQUENCES;i++)
  {
    for (int p=0;p<NBLED;p++)
    {
      boolean etat=affichage[i][p];
      digitalWrite(pinLed[p],etat);
    }
    delay(500);
  }
  delay(1000);

}
